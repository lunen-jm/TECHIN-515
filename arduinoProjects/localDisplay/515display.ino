#include <ArduinoBLE.h>
#include <Adafruit_NeoPixel.h>

// UUIDs from the transmitter
const char* SERVICE_UUID = "09279c9d-dd87-40d1-877b-00d951d18cda";
const char* CHARACTERISTIC_UUID = "a2670365-1a16-4ef5-a53e-371324f03243";

#define BUTTON_PIN_1 5
#define BUTTON_PIN_2 6
#define LED_PIN      44
#define NUM_PIXELS   2

Adafruit_NeoPixel pixels(NUM_PIXELS, LED_PIN, NEO_GRB + NEO_KHZ800);

// Parsed sensor data
uint16_t distance1 = 0;
uint16_t distance2 = 0;
uint16_t distanceavg = 0;
uint16_t co2 = 0;
float temperature = 0.0;
float humidity = 0.0;

#include "TFT_eSPI.h"
#include <Adafruit_GFX.h>
// #include <Fonts/FreeSansBold24pt7b.h>

#ifdef EPAPER_ENABLE // Only compile this code if the EPAPER_ENABLE is defined in User_Setup.h
EPaper epaper;
#endif

const unsigned char CO2[] PROGMEM = {
// 'CO2, 32x32px
  0x00, 0x00, 0x00, 0x00, 0x00, 0x00, 0x00, 0x00, 0x00, 0x00, 0x00, 0x00, 0x00, 0x07, 0xe0, 0x00, 
  0x00, 0x3f, 0xfc, 0x00, 0x00, 0x7f, 0xfe, 0x00, 0x00, 0xf8, 0x1f, 0x00, 0x01, 0xe0, 0x07, 0x80, 
  0x33, 0xc0, 0x03, 0xdc, 0x3f, 0x80, 0x01, 0xfc, 0x3f, 0x1c, 0x39, 0xfc, 0x0f, 0x1c, 0x38, 0xf0, 
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  0x00, 0x3f, 0xfc, 0x00, 0x00, 0x07, 0xe0, 0x00, 0x00, 0x00, 0x00, 0x00, 0x00, 0x00, 0x00, 0x00
};

const unsigned char TEMPERATURE[] PROGMEM = {
// 'Temperature, 32x32px
  0x00, 0x00, 0x00, 0x00, 0x00, 0x03, 0xc0, 0x00, 0x00, 0x0f, 0xf0, 0x00, 0x00, 0x1f, 0xf8, 0x00, 
  0x00, 0x1e, 0x78, 0x00, 0x00, 0x1c, 0x38, 0x00, 0x00, 0x18, 0x18, 0x00, 0x00, 0x18, 0x18, 0x00, 
  0x00, 0x18, 0x18, 0x00, 0x00, 0x18, 0x18, 0x00, 0x00, 0x19, 0x98, 0x00, 0x00, 0x19, 0x98, 0x00, 
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  0x00, 0x7c, 0x3e, 0x00, 0x00, 0x3f, 0xfc, 0x00, 0x00, 0x1f, 0xf8, 0x00, 0x00, 0x07, 0xe0, 0x00
};

const unsigned char HUMIDITY[] PROGMEM = {
// 'Humidity, 32x32px
    0x00, 0x00, 0x00, 0x00, 0x00, 0x01, 0x80, 0x00, 0x00, 0x03, 0xc0, 0x00, 0x00, 0x0f, 0xf0, 0x00, 
  0x00, 0x1f, 0xf8, 0x00, 0x00, 0x3e, 0x7c, 0x00, 0x00, 0x3c, 0x3c, 0x00, 0x00, 0x78, 0x1e, 0x00, 
  0x00, 0xf0, 0x0f, 0x00, 0x01, 0xe0, 0x07, 0x80, 0x01, 0xc0, 0x03, 0x80, 0x03, 0xc0, 0x03, 0xc0, 
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  0x00, 0x3f, 0xfc, 0x00, 0x00, 0x07, 0xe0, 0x00, 0x00, 0x00, 0x00, 0x00, 0x00, 0x00, 0x00, 0x00
};

const unsigned char CONNECTIVITY[] PROGMEM = {
// 'Connectivity, 32x32px
  0x00, 0x00, 0x00, 0x00, 0x00, 0x00, 0x00, 0x00, 0x00, 0x00, 0x00, 0x00, 0x00, 0x00, 0x00, 0x00, 
  0x00, 0x00, 0x00, 0x00, 0x00, 0x00, 0x00, 0x00, 0x00, 0x1f, 0xf8, 0x00, 0x00, 0xff, 0xff, 0x00, 
  0x03, 0xff, 0xff, 0xc0, 0x0f, 0xf0, 0x0f, 0xf0, 0x1f, 0x80, 0x01, 0xf8, 0x3e, 0x00, 0x00, 0x7c, 
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  0x00, 0x00, 0x00, 0x00, 0x00, 0x00, 0x00, 0x00, 0x00, 0x00, 0x00, 0x00, 0x00, 0x00, 0x00, 0x00
};

BLEDevice peripheral;
BLECharacteristic dataChar;

void setup() {
  Serial.begin(115200);
  // while (!Serial);

  if (!BLE.begin()) {
    Serial.println("❌ Failed to initialize BLE");
    while (1);
  }

  Serial.println("🔍 Scanning for BLE devices...");
  BLE.scanForUuid(SERVICE_UUID);

  epaper.begin();
  epaper.fillScreen(TFT_WHITE);
}

void loop() {
  // Reconnect if disconnected
  if (peripheral && !peripheral.connected()) {
    Serial.println("🔌 Disconnected. Rescanning...");
    pixels.setPixelColor(1, pixels.Color(255, 0, 0));  
    pixels.show();
    peripheral = BLEDevice(); // reset
    BLE.scanForUuid(SERVICE_UUID);
    return;
  }

  // If not connected, try to connect to the sensor peripheral
  if (!peripheral) {
    peripheral = BLE.available();
    if (peripheral) {
      Serial.print("✅ Found device: ");
      Serial.println(peripheral.localName());

      if (peripheral.connect()) {
        Serial.println("🔗 Connected. Discovering service...");
        pixels.setPixelColor(1, pixels.Color(0, 0, 255));  
        pixels.show();
        if (peripheral.discoverService(SERVICE_UUID)) {
          dataChar = peripheral.characteristic(CHARACTERISTIC_UUID);
          if (!dataChar) {
            Serial.println("❌ Failed to find characteristic");
            pixels.setPixelColor(1, pixels.Color(255, 0, 0));  
            pixels.show();
            peripheral.disconnect();
          } else {
            Serial.println("✅ Characteristic connected");
            pixels.setPixelColor(1, pixels.Color(0, 255, 0));  
            pixels.show();
            dataChar.subscribe();  // Subscribe to notifications
          }
        } else {
          Serial.println("❌ Failed to discover service");
          pixels.setPixelColor(1, pixels.Color(255, 0, 0));  
          pixels.show();
          peripheral.disconnect();
        }
      } else {
        Serial.println("❌ Connection failed");
        pixels.setPixelColor(1, pixels.Color(255, 0, 0));  
        pixels.show();
      }
    }
    return;
  }

  // If connected, check for new data
  if (dataChar && dataChar.valueUpdated()) {
    int length = dataChar.valueLength();
    uint8_t buffer[100];
    dataChar.readValue(buffer, length);
    buffer[length] = '\0';  // Null-terminate for safe conversion

    String jsonStr = String((char*)buffer);  // Convert to String
    Serial.print("📦 Received: ");
    Serial.println(jsonStr);

    parseJSON(jsonStr);
  }

  BLE.poll();  // Keep BLE events running
  
  epaper.fillScreen(TFT_WHITE);
  epaper.drawRect(20, 20, 370, 440, TFT_BLACK);
  epaper.drawLine(20, 70, 390, 70, TFT_BLACK);
  epaper.drawRect(410, 20, 370, 95, TFT_BLACK);
  epaper.drawRect(410, 135, 370, 95, TFT_BLACK);
  epaper.drawRect(410, 250, 370, 95, TFT_BLACK);
  epaper.drawRect(410, 365, 370, 95, TFT_BLACK);
  epaper.drawBitmap(430, 51.5, CO2, 32, 32, TFT_BLACK);
  epaper.drawBitmap(430, 166.5, TEMPERATURE, 32, 32, TFT_BLACK);
  epaper.drawBitmap(430, 281.5, HUMIDITY, 32, 32, TFT_BLACK);
  epaper.drawBitmap(430, 396.5, CONNECTIVITY, 32, 32, TFT_BLACK);

  epaper.setFreeFont(&FreeSansBold12pt7b);
  epaper.drawString("CO2 (ppm)", 478, 57);
  epaper.drawString("Temp (°C)", 478, 172);
  epaper.drawString("Hum (%)", 478, 287);
  epaper.drawString("Connection", 478, 402);

  epaper.drawString(String(co2), 700, 57);
  epaper.drawString(String(temperature, 1), 700, 172);
  epaper.drawString(String(humidity, 1), 700, 287);

  epaper.setFreeFont(&FreeSansBold18pt7b);
  epaper.drawString(String(distanceavg), 32, 32);
  epaper.drawString(String(100-distanceavg*100/700)+"%", 100, 32);

  epaper.fillRect(20, 70+distanceavg*390/700, 370, 390-distanceavg*390/700, TFT_BLACK);

  epaper.update(); // update the display
}

// Helper to extract values from JSON-like strings
String extractValue(String& json, const String& key) {
  int startIndex = json.indexOf("\"" + key + "\":");
  if (startIndex == -1) return "";
  startIndex += key.length() + 3;
  int endIndex = json.indexOf(",", startIndex);
  if (endIndex == -1) endIndex = json.indexOf("}", startIndex);
  return json.substring(startIndex, endIndex);
}

// Parse JSON string into variables
void parseJSON(String json) {
  distance1   = extractValue(json, "d1").toInt();
  distance2   = extractValue(json, "d2").toInt();
  distanceavg = (distance1+distance2)/2;
  co2         = extractValue(json, "co2").toInt();
  temperature = extractValue(json, "t").toFloat();
  humidity    = extractValue(json, "h").toFloat();

  Serial.print("📊 Parsed → D1: "); Serial.print(distance1);
  Serial.print(" | D2: "); Serial.print(distance2);
  Serial.print(" | DA: "); Serial.print(distanceavg);
  Serial.print(" | CO2: "); Serial.print(co2);
  Serial.print(" | Temp: "); Serial.print(temperature);
  Serial.print(" | Hum: "); Serial.println(humidity);
}
